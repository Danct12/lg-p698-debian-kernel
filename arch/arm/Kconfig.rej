## arch/arm/Kconfig.rej
```kconfig
--- arch/arm/Kconfig
+++ arch/arm/Kconfig
@@ -1027,18 +1028,6 @@ config PL310_ERRATA_588369
 	   is not correctly implemented in PL310 as clean lines are not
 	   invalidated as a result of these operations. Note that this errata
 	   uses Texas Instrument's secure monitor api.
-
-config ARM_ERRATA_720789
-	bool "ARM errata: TLBIASIDIS and TLBIMVAIS operations can broadcast a faulty ASID"
-	depends on CPU_V7 && SMP
-	help
-	  This option enables the workaround for the 720789 Cortex-A9 (prior to
-	  r2p0) erratum. A faulty ASID can be sent to the other CPUs for the
-	  broadcasted CP15 TLB maintenance operations TLBIASIDIS and TLBIMVAIS.
-	  As a consequence of this erratum, some TLB entries which should be
-	  invalidated are not, resulting in an incoherency in the system page
-	  tables. The workaround changes the TLB flushing routines to invalidate
-	  entries regardless of the ASID.
 endmenu
 
 source "arch/arm/common/Kconfig"
```

## arch/x86/Kconfig.rej
```kconfig
--- arch/x86/Kconfig
+++ arch/x86/Kconfig
@@ -792,17 +787,6 @@ config SCHED_MC
 	  making when dealing with multi-core CPU chips at a cost of slightly
 	  increased overhead in some places. If unsure say N here.
 
-config IRQ_TIME_ACCOUNTING
-	bool "Fine granularity task level IRQ time accounting"
-	default n
-	---help---
-	  Select this option to enable fine granularity task irq time
-	  accounting. This is done by reading a timestamp on each
-	  transitions between softirq and hardirq state, so there can be a
-	  small performance impact.
-
-	  If in doubt, say N here.
-
 source "kernel/Kconfig.preempt"
 
 config X86_UP_APIC
```
